#include <Bounce2.h>
#include <Adafruit_GFX.h>
#include <Adafruit_SSD1306.h>
#include <RCSwitch.h>

#define BUTTON_PIN_SEND 4
#define BUTTON_PIN_UP 5
#define BUTTON_PIN_DOWN 8
#define BUTTON_PIN_SOUND 7
#define RADIO_DATA_PIN 10
#define SCREEN_WIDTH 128
#define SCREEN_HEIGHT 32
#define MAX_DELAY 30

RCSwitch radio = RCSwitch();
Bounce btnSend = Bounce();
Bounce btnUp = Bounce();
Bounce btnDown = Bounce();
Bounce btnSound = Bounce();
Adafruit_SSD1306 display(SCREEN_WIDTH, SCREEN_HEIGHT, &Wire, -1);
bool nowSend = false;

struct {
  unsigned soundEnable : 1;
  unsigned shotDelay : 5;
  unsigned key : 6;
} radioData;

static const unsigned char PROGMEM noSoundBitmap[] = {
  0x00, 0x00, 0x00, 0x00, 0x00, 0x00, 0x00, 0x00, 0x00, 0x00, 0x00, 0x00, 0x00, 0x00, 0x00, 0x00,
  0x00, 0x03, 0x00, 0x00, 0x00, 0x07, 0x00, 0x00, 0x00, 0x0f, 0x00, 0x00, 0x00, 0x1f, 0x00, 0x00,
  0x00, 0x3f, 0x00, 0x00, 0x00, 0x7f, 0x00, 0x00, 0x00, 0xff, 0x00, 0x00, 0x7f, 0xff, 0x0c, 0x18,
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  0x00, 0x00, 0x00, 0x00, 0x00, 0x00, 0x00, 0x00, 0x00, 0x00, 0x00, 0x00, 0x00, 0x00, 0x00, 0x00
};

static const unsigned char PROGMEM soundBitmap[] = {
  0x00, 0x00, 0x00, 0x00, 0x00, 0x00, 0x00, 0x00, 0x00, 0x00, 0x06, 0x00, 0x00, 0x00, 0x07, 0x80,
  0x00, 0x03, 0x07, 0xe0, 0x00, 0x07, 0x01, 0xf0, 0x00, 0x0f, 0x00, 0xf8, 0x00, 0x1f, 0x18, 0x78,
  0x00, 0x3f, 0x1e, 0x3c, 0x00, 0x7f, 0x1f, 0x1e, 0x00, 0xff, 0x0f, 0x8e, 0x7f, 0xff, 0x03, 0xce,
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  0x00, 0x00, 0x07, 0x80, 0x00, 0x00, 0x07, 0x00, 0x00, 0x00, 0x00, 0x00, 0x00, 0x00, 0x00, 0x00
};

static const unsigned char PROGMEM walkieTalkieBitmap[] = {
  0x00, 0x00, 0x00, 0x00, 0x00, 0x00, 0x00, 0x00, 0x00, 0x00, 0x00, 0x00, 0x00, 0x00, 0x00, 0x00,
  0x00, 0x00, 0x00, 0x00, 0x00, 0x00, 0x10, 0x00, 0x00, 0x00, 0x10, 0x00, 0x00, 0x00, 0x10, 0x00,
  0x00, 0x00, 0x10, 0x00, 0x00, 0x00, 0x10, 0x00, 0x00, 0x00, 0x10, 0x00, 0x00, 0x00, 0x10, 0x00,
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  0x00, 0x20, 0x04, 0x00, 0x00, 0x20, 0x04, 0x00, 0x00, 0x20, 0x04, 0x00, 0x00, 0x3f, 0xfc, 0x00
};

static const unsigned char PROGMEM walkieTalkieSendBitmap[] = {
  0x00, 0x04, 0x7c, 0x40, 0x00, 0x08, 0x82, 0x20, 0x00, 0x09, 0x01, 0x20, 0x00, 0x12, 0x38, 0x90,
  0x00, 0x12, 0x44, 0x90, 0x00, 0x12, 0x54, 0x90, 0x00, 0x12, 0x54, 0x90, 0x00, 0x12, 0x38, 0x90,
  0x00, 0x09, 0x11, 0x20, 0x00, 0x08, 0x92, 0x20, 0x00, 0x04, 0x7c, 0x40, 0x00, 0x02, 0x10, 0x80,
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  0x00, 0x20, 0x04, 0x00, 0x00, 0x20, 0x04, 0x00, 0x00, 0x20, 0x04, 0x00, 0x00, 0x3f, 0xfc, 0x00
};

void setup() {
  radioData.soundEnable = true;
  radioData.shotDelay = 3;
  radioData.key = 0b110011;
  radio.enableTransmit(RADIO_DATA_PIN);
  radio.setProtocol(12);

  display.begin(SSD1306_SWITCHCAPVCC, 0x3C);
  display.setTextSize(3);
  display.setTextColor(WHITE);
  displayInfo();

  btnSend.attach(BUTTON_PIN_SEND, INPUT_PULLUP);
  btnUp.attach(BUTTON_PIN_UP, INPUT_PULLUP);
  btnDown.attach(BUTTON_PIN_DOWN, INPUT_PULLUP);
  btnSound.attach(BUTTON_PIN_SOUND, INPUT_PULLUP);
  btnSend.interval(25);
  btnUp.interval(25);
  btnDown.interval(25);
  btnSound.interval(25);
}

void loop() {
  btnSend.update();
  btnUp.update();
  btnDown.update();
  btnSound.update();
  if (btnSend.fell()) {
    nowSend = true;
    displayInfo();
    radio.send(*(int*)&radioData, 12);
    nowSend = false;
    displayInfo();
  }
  if (btnUp.fell()) {
    radioData.shotDelay++;
    if (radioData.shotDelay > MAX_DELAY) {
      radioData.shotDelay = 0;
    }
    displayInfo();
  }
  if (btnDown.fell()) {
    radioData.shotDelay--;
    if (radioData.shotDelay > MAX_DELAY) {
      radioData.shotDelay = MAX_DELAY;
    }
    displayInfo();
  }
  if (btnSound.fell()) {
    radioData.soundEnable = !radioData.soundEnable;
    displayInfo();
  }
}

void displayInfo() {
  int x, y;
  unsigned int width, height;
  String printShotDelay;
  if (radioData.shotDelay < 10) {
    printShotDelay = '0' + String(radioData.shotDelay);
  } else {
    printShotDelay = radioData.shotDelay;
  }
  display.getTextBounds(printShotDelay, 0, 0, &x, &y, &width, &height);
  display.clearDisplay();
  display.setCursor(0, (SCREEN_HEIGHT - height) / 2);
  display.print(printShotDelay);
  if (radioData.soundEnable) {
    display.drawBitmap((SCREEN_WIDTH - 32) / 2, 0, soundBitmap, 32, 32, 1);
  } else {
    display.drawBitmap((SCREEN_WIDTH - 32) / 2, 0, noSoundBitmap, 32, 32, 1);
  }
  if (nowSend) {
    display.drawBitmap(SCREEN_WIDTH - 32, 0, walkieTalkieSendBitmap, 32, 32, 1);
  } else {
    display.drawBitmap(SCREEN_WIDTH - 32, 0, walkieTalkieBitmap, 32, 32, 1);
  }
  display.display();
}
